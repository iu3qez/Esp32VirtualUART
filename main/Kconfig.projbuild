## main/Kconfig.projbuild
```kconfig
menu "Virtual UART Configuration"

    config VUART_STATUS_LED_GPIO
        int "Status LED GPIO number"
        default 48
        help
            GPIO number for the addressable RGB LED (WS2812).
            Default 48 is for ESP32-S3-DevKitC. Set to your board's LED GPIO.
            Set to -1 to disable the status LED.

    config VUART_ETHERNET_ENABLED
        bool "Enable Ethernet (IP101 PHY)"
        default y
        help
            Enable Ethernet support using the internal EMAC and IP101 PHY.
            This is for the Guition JC-ESP32P4-M3-Dev board with IP101.
            Disable if your board does not have Ethernet hardware.

endmenu
```

## sdkconfig.defaults
```kconfig
CONFIG_IDF_TARGET="esp32p4"

# CPU: 360MHz dual-core RISC-V
CONFIG_ESP_DEFAULT_CPU_FREQ_MHZ_360=y
CONFIG_ESP_DEFAULT_CPU_FREQ_MHZ=360

# Flash: 16MB, QIO mode, 80MHz
CONFIG_ESPTOOLPY_FLASHSIZE_16MB=y
CONFIG_ESPTOOLPY_FLASHMODE_QIO=y
CONFIG_ESPTOOLPY_FLASHFREQ_80M=y

# PSRAM: 32MB Hex SPI (P4 uses HEX mode, not OCT)
CONFIG_SPIRAM=y
CONFIG_SPIRAM_MODE_HEX=y
CONFIG_SPIRAM_SPEED_200M=y
CONFIG_SPIRAM_BOOT_INIT=y
CONFIG_SPIRAM_MALLOC_ALWAYSINTERNAL=4096
CONFIG_SPIRAM_MALLOC_RESERVE_INTERNAL=32768
CONFIG_SPIRAM_TRY_ALLOCATE_WIFI_LWIP=y

# Compiler: Optimize for performance
CONFIG_COMPILER_OPTIMIZATION_PERF=y

# USB TinyUSB - High-Speed USB
# NOTE: Kconfig limits CDC_COUNT to 2. Override to 3 is done via CMakeLists.txt sed patch.
CONFIG_TINYUSB_CDC_ENABLED=y
CONFIG_TINYUSB_CDC_COUNT=2
CONFIG_TINYUSB_CDC_RX_BUFSIZE=4096
CONFIG_TINYUSB_CDC_TX_BUFSIZE=4096
CONFIG_TINYUSB_RHPORT_HS=y

# USB descriptors
CONFIG_TINYUSB_DESC_USE_ESPRESSIF_VID=n
CONFIG_TINYUSB_DESC_CUSTOM_VID=0x1234
CONFIG_TINYUSB_DESC_CUSTOM_PID=0x5678
CONFIG_TINYUSB_DESC_MANUFACTURER_STRING="VirtualUART"
CONFIG_TINYUSB_DESC_PRODUCT_STRING="ESP32-P4 Virtual UART"
CONFIG_TINYUSB_DESC_SERIAL_STRING=""

# Partition table
CONFIG_PARTITION_TABLE_CUSTOM=y
CONFIG_PARTITION_TABLE_CUSTOM_FILENAME="partitions.csv"

# HTTP server with WebSocket support
CONFIG_HTTPD_WS_SUPPORT=y

# ESP-Hosted: C6 companion via SDIO (Guition JC-ESP32P4-M3-Dev)
# Func Board preset auto-configures SDIO GPIOs: CLK=18, CMD=19, D0=14, D1=15, D2=16, D3=17, Reset=54
CONFIG_SLAVE_IDF_TARGET_ESP32C6=y
CONFIG_ESP_HOSTED_P4_DEV_BOARD_FUNC_BOARD=y

# WiFi remote buffer tuning (from ESP-Hosted P4 docs)
CONFIG_WIFI_RMT_STATIC_RX_BUFFER_NUM=16
CONFIG_WIFI_RMT_DYNAMIC_RX_BUFFER_NUM=64
CONFIG_WIFI_RMT_DYNAMIC_TX_BUFFER_NUM=64
CONFIG_WIFI_RMT_AMPDU_TX_ENABLED=y
CONFIG_WIFI_RMT_TX_BA_WIN=32
CONFIG_WIFI_RMT_AMPDU_RX_ENABLED=y
CONFIG_WIFI_RMT_RX_BA_WIN=32

# Ethernet: Internal EMAC + IP101 PHY
CONFIG_ETH_USE_ESP32_EMAC=y

# FreeRTOS
CONFIG_FREERTOS_HZ=1000

# LWIP
CONFIG_LWIP_IRAM_OPTIMIZATION=y
```
